## esp-idf/benchtest/sdkconfig.defaults
```kconfig
CONFIG_PARTITION_TABLE_SINGLE_APP_LARGE=y
CONFIG_ESPTOOLPY_FLASHSIZE_4MB=y
CONFIG_HONCH_PERF_LOGGING=y
```

## esp-idf/example/sdkconfig.defaults
```kconfig
CONFIG_ESP_HTTP_CLIENT_ENABLE_HTTPS=y
CONFIG_MBEDTLS_CERTIFICATE_BUNDLE=y
CONFIG_PARTITION_TABLE_SINGLE_APP_LARGE=y
```

## esp-idf/honch/Kconfig
```kconfig
menu "Honch SDK"

    config HONCH_LOG_VERBOSE
        bool "Enable verbose logging"
        default n
        help
            Enable extra debug logging from the Honch SDK.
            Adds detailed logs for queue operations, encoding,
            and transport activity.

    config HONCH_MAX_QUEUE_DEPTH
        int "Maximum event queue depth"
        default 256
        range 16 1024
        help
            Maximum number of events that can be stored in the
            NVS-backed queue before the oldest events are dropped.

    config HONCH_ENABLE_GZIP
        bool "Enable gzip compression for large CBOR batches"
        default y
        help
            Compress HTTP CBOR batches when they are large enough to benefit.
            If compression fails or does not reduce the payload, the SDK sends
            the original raw CBOR body.

    config HONCH_GZIP_MIN_BYTES
        int "Minimum CBOR payload size for gzip"
        default 1024
        range 0 65536
        depends on HONCH_ENABLE_GZIP
        help
            Minimum encoded CBOR batch size before the SDK attempts gzip.
            Smaller batches are sent as raw application/cbor.

endmenu
```

## ports/esp-idf/benchtest/main/Kconfig.projbuild
```kconfig
menu "Honch Benchtest Configuration"

    config HONCH_API_KEY
        string "Honch API Key"
        default ""
        help
            Your Honch project API key.

    config HONCH_HOST
        string "Honch Host"
        default "https://capture.honch.io"
        help
            The Honch capture endpoint URL.

    config WIFI_SSID
        string "Wi-Fi SSID"
        default ""
        help
            SSID of the Wi-Fi network to connect to.

    config WIFI_PASSWORD
        string "Wi-Fi Password"
        default ""
        help
            Password for the Wi-Fi network.

    config BENCH_EVENT_COUNT
        int "Benchmark event count"
        default 250
        range 1 10000
        help
            Number of bench_event calls to emit per benchmark run.

    config BENCH_EVENT_INTERVAL_MS
        int "Delay between benchmark events (ms)"
        default 100
        range 0 60000
        help
            Delay between honch_track calls. Use 0 for a burst test.

    config BENCH_FLUSH_EVERY
        int "Flush after this many events"
        default 25
        range 1 1000
        help
            Calls honch_flush after each group of this many events.

    config BENCH_PAYLOAD_BYTES
        int "Approximate custom property payload bytes"
        default 64
        range 0 512
        help
            Adds a string property with roughly this many bytes to each event.

    config BENCH_SETTLE_SECONDS
        int "Seconds to wait after final flush"
        default 10
        range 0 300
        help
            Time to wait after the final flush so async HTTP work can finish.

    config BENCH_OFFLINE_QUEUE_PROOF
        bool "Run offline queue preservation proof"
        default n
        help
            Skip capture readiness at startup, emit events while capture is
            expected to be unavailable, verify the queued estimate grows, then
            retry flushes until capture is restored.

    config BENCH_OFFLINE_QUEUE_PROOF_EVENTS
        int "Offline queue proof event count"
        default 40
        range 1 1000
        depends on BENCH_OFFLINE_QUEUE_PROOF
        help
            Number of proof events to queue before the recovery flush loop.

    config BENCH_OFFLINE_RECOVERY_RETRY_SECONDS
        int "Offline proof recovery retry delay seconds"
        default 5
        range 1 300
        depends on BENCH_OFFLINE_QUEUE_PROOF
        help
            Delay between flush attempts while waiting for capture to recover.

    config BENCH_REPEAT
        bool "Repeat benchmark runs forever"
        default n
        help
            Repeat the benchmark after a short pause.

endmenu
```

## ports/esp-idf/example/main/Kconfig.projbuild
```kconfig
menu "Honch Example Configuration"

    config HONCH_API_KEY
        string "Honch API Key"
        default ""
        help
            Your Honch project API key.

    config HONCH_HOST
        string "Honch Host"
        default "https://capture.honch.io"
        help
            The Honch capture endpoint URL.

    config WIFI_SSID
        string "Wi-Fi SSID"
        default ""
        help
            SSID of the Wi-Fi network to connect to.

    config WIFI_PASSWORD
        string "Wi-Fi Password"
        default ""
        help
            Password for the Wi-Fi network.

    config HONCH_IDENTIFY_PILOT
        bool "Run one-shot identify pilot validation"
        default n
        help
            Sends a pre-identify event, identify call, post-identify event, and
            flush with serial markers for real ESP32 hardware validation.

endmenu
```

## ports/esp-idf/example_gpio/main/Kconfig.projbuild
```kconfig
menu "Honch GPIO Example Configuration"

    config HONCH_API_KEY
        string "Honch API Key"
        default ""
        help
            Your Honch project API key.

    config HONCH_HOST
        string "Honch Host"
        default "https://capture.honch.io"
        help
            The Honch capture endpoint URL.

    config WIFI_SSID
        string "Wi-Fi SSID"
        default ""
        help
            SSID of the Wi-Fi network to connect to.

    config WIFI_PASSWORD
        string "Wi-Fi Password"
        default ""
        help
            Password for the Wi-Fi network.

    config HONCH_GPIO_BUTTON
        int "Button GPIO"
        default 0
        help
            GPIO number to track. GPIO 0 is the BOOT button on many ESP32 dev boards.

endmenu
```

## ports/esp-idf/honch/Kconfig
```kconfig
menu "Honch SDK"

config HONCH_ERROR_TRACKING
    bool "Enable automatic error tracking"
    default y
    help
        Compile Honch automatic error tracking support. Disable this to strip
        the SDK-owned fault snapshot and $error emission path from firmware.

config HONCH_CRASH_SYMBOLICATION
    bool "Enable crash symbolication context"
    depends on HONCH_ERROR_TRACKING
    default y
    help
        Include firmware build IDs and raw crash addresses from ESP-IDF ELF
        coredump summaries so Honch can resolve function and source lines after
        matching symbols are uploaded.

        When the ELF coredump-to-flash options are also enabled
        (CONFIG_ESP_COREDUMP_ENABLE_TO_FLASH + CONFIG_ESP_COREDUMP_DATA_FORMAT_ELF)
        and a "coredump" partition exists, the SDK additionally streams the raw
        coredump image off flash to Honch after a crash and erases it once Honch
        acknowledges the upload. See the README "Crash coredump upload" section.

config HONCH_LIFECYCLE_EVENTS
    bool "Enable automatic lifecycle events"
    default y
    help
        Emit $device_boot, $firmware_update, and $device_shutdown
        automatically. Disable to compile these out; the firmware-version
        baseline is still maintained so re-enabling never spuriously re-emits.

config HONCH_SESSIONS
    bool "Enable session tracking"
    default y
    help
        Emit $session_start / $session_end via the session API. Disable to
        compile the session-tracking code out; the session_id event field is
        always retained.

config HONCH_BATTERY
    bool "Enable battery telemetry"
    default y
    help
        Emit the $battery_level auto-property and the $battery_low edge event.
        Disable to compile the battery sampling/emission out (the public
        battery config fields remain).

endmenu
```

## ports/esp-idf/local/sdkconfig.defaults.example
```kconfig
CONFIG_WIFI_SSID="your-ssid"
CONFIG_WIFI_PASSWORD="your-password"
CONFIG_HONCH_API_KEY="honch_e2e_test_key"
CONFIG_HONCH_HOST="http://192.168.1.122:8001"
```

## ports/esp-idf/rate_sweep_bench/main/Kconfig.projbuild
```kconfig
menu "Honch Rate Sweep Benchmark Configuration"

    config HONCH_API_KEY
        string "Honch API Key"
        default ""
        help
            Your Honch project API key.

    config HONCH_HOST
        string "Honch Host"
        default "https://capture.honch.io"
        help
            The Honch capture endpoint URL.

    config WIFI_SSID
        string "Wi-Fi SSID"
        default ""
        help
            SSID of the Wi-Fi network to connect to.

    config WIFI_PASSWORD
        string "Wi-Fi Password"
        default ""
        help
            Password for the Wi-Fi network.

    config RATE_SWEEP_RATES
        string "Target events per second"
        default "100,500,1000,3000"
        help
            Comma-separated target event rates. The benchmark reports actual
            achieved EPS for each window, so saturated targets remain useful.

    config RATE_SWEEP_DURATION_SECONDS
        int "Measured duration per target"
        default 20
        range 1 300
        help
            Number of measured seconds to run for each target rate.

    config RATE_SWEEP_WARMUP_SECONDS
        int "Warmup seconds per target"
        default 3
        range 0 60
        help
            Warmup time before measured windows for each target rate.

    config RATE_SWEEP_WINDOW_SECONDS
        int "Metric window seconds"
        default 1
        range 1 10
        help
            Duration of each BENCH_WINDOW measurement bucket.

    config RATE_SWEEP_FLUSH_EVERY
        int "Flush cadence in accepted events"
        default 100
        range 1 1000
        help
            Calls honch_flush after this many accepted events.

    config RATE_SWEEP_PAYLOAD_BYTES
        int "Approximate custom property payload bytes"
        default 64
        range 0 512
        help
            Adds a string property with roughly this many bytes to each event.

    config RATE_SWEEP_SETTLE_SECONDS
        int "Seconds to wait after suite"
        default 10
        range 0 300
        help
            Time to wait after the final flush so async HTTP work can finish.

    config RATE_SWEEP_MAX_WINDOW_SAMPLES
        int "Max track samples per window"
        default 4096
        range 128 10000
        help
            Bounded static sample capacity used for per-window latency
            percentiles. Keep above max EPS times window seconds.

endmenu
```

## ports/esp-idf/rate_sweep_bench/sdkconfig.defaults
```kconfig
CONFIG_PARTITION_TABLE_SINGLE_APP_LARGE=y
CONFIG_ESPTOOLPY_FLASHSIZE_4MB=y
CONFIG_FREERTOS_USE_TRACE_FACILITY=y
CONFIG_FREERTOS_GENERATE_RUN_TIME_STATS=y
CONFIG_FREERTOS_RUN_TIME_STATS_USING_ESP_TIMER=y
```
